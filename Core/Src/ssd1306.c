#include "ssd1306.h"

#include <string.h>

#define SSD1306_TIMEOUT_MS  20U

static const uint8_t font5x7[96][5] =
{
  {0x00,0x00,0x00,0x00,0x00}, {0x00,0x00,0x5F,0x00,0x00},
  {0x00,0x07,0x00,0x07,0x00}, {0x14,0x7F,0x14,0x7F,0x14},
  {0x24,0x2A,0x7F,0x2A,0x12}, {0x23,0x13,0x08,0x64,0x62},
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  {0x08,0x04,0x08,0x10,0x08}, {0x00,0x00,0x00,0x00,0x00}
};

static HAL_StatusTypeDef SSD1306_SendCommands(SSD1306_Handle *display,
                                               const uint8_t *commands,
                                               uint8_t count)
{
  uint8_t packet[32];

  if (count > (sizeof(packet) - 1U))
  {
    return HAL_ERROR;
  }

  packet[0] = 0x00U;
  memcpy(&packet[1], commands, count);
  return HAL_I2C_Master_Transmit(display->i2c, SSD1306_I2C_ADDRESS, packet,
                                 (uint16_t)count + 1U, SSD1306_TIMEOUT_MS);
}

HAL_StatusTypeDef SSD1306_Init(SSD1306_Handle *display,
                               I2C_HandleTypeDef *i2c)
{
  static const uint8_t init_commands[] =
  {
    0xAEU, 0x20U, 0x02U, 0xB0U, 0xC8U, 0x00U, 0x10U, 0x40U,
    0x81U, 0x7FU, 0xA1U, 0xA6U, 0xA8U, 0x3FU, 0xA4U, 0xD3U,
    0x00U, 0xD5U, 0x80U, 0xD9U, 0xF1U, 0xDAU, 0x12U, 0xDBU,
    0x40U, 0x8DU, 0x14U, 0xAFU
  };

  if ((display == NULL) || (i2c == NULL))
  {
    return HAL_ERROR;
  }

  display->i2c = i2c;
  display->available = 0U;

  if (HAL_I2C_IsDeviceReady(i2c, SSD1306_I2C_ADDRESS, 2U,
                            SSD1306_TIMEOUT_MS) != HAL_OK)
  {
    return HAL_ERROR;
  }

  if (SSD1306_SendCommands(display, init_commands,
                           (uint8_t)sizeof(init_commands)) != HAL_OK)
  {
    return HAL_ERROR;
  }

  display->available = 1U;
  SSD1306_Clear(display);
  return SSD1306_Update(display);
}

void SSD1306_Clear(SSD1306_Handle *display)
{
  if (display != NULL)
  {
    memset(display->buffer, 0, sizeof(display->buffer));
  }
}

void SSD1306_WriteLine(SSD1306_Handle *display, uint8_t line,
                       const char *text)
{
  uint16_t position;
  uint8_t column;
  uint8_t character;

  if ((display == NULL) || (text == NULL) || (line >= 8U))
  {
    return;
  }

  position = (uint16_t)line * SSD1306_WIDTH;
  memset(&display->buffer[position], 0, SSD1306_WIDTH);

  while ((*text != '\0') && (position <= ((uint16_t)(line + 1U) *
                                            SSD1306_WIDTH - 6U)))
  {
    character = (uint8_t)*text;
    if ((character < 32U) || (character > 127U))
    {
      character = (uint8_t)'?';
    }

    for (column = 0U; column < 5U; column++)
    {
      display->buffer[position++] = font5x7[character - 32U][column];
    }
    display->buffer[position++] = 0x00U;
    text++;
  }
}

HAL_StatusTypeDef SSD1306_Update(SSD1306_Handle *display)
{
  uint8_t page;
  uint8_t commands[3];
  uint8_t packet[SSD1306_WIDTH + 1U];

  if ((display == NULL) || (display->i2c == NULL) ||
      (display->available == 0U))
  {
    return HAL_ERROR;
  }

  packet[0] = 0x40U;
  for (page = 0U; page < 8U; page++)
  {
    commands[0] = (uint8_t)(0xB0U + page);
    commands[1] = 0x00U;
    commands[2] = 0x10U;
    if (SSD1306_SendCommands(display, commands, 3U) != HAL_OK)
    {
      return HAL_ERROR;
    }

    memcpy(&packet[1], &display->buffer[(uint16_t)page * SSD1306_WIDTH],
           SSD1306_WIDTH);
    if (HAL_I2C_Master_Transmit(display->i2c, SSD1306_I2C_ADDRESS, packet,
                                sizeof(packet), SSD1306_TIMEOUT_MS) != HAL_OK)
    {
      return HAL_ERROR;
    }
  }

  return HAL_OK;
}
